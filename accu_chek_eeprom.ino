//#define BUFFER_LENGTH 32
#include <Wire.h>
#include <Eeprom24C04_16.h>

byte arr[2048] = {0xD3,0x7F,0x01,0x09,0x72,0x12,0x22,0xFF,0xFF,0x22,0x35,0x06,0x0D,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0xFF,0xFF};

static Eeprom24C04_16 eeprom(0x50);

void setup()
{
    Serial.begin(57600);
    eeprom.initialize();
    
    int adres = 0;

    Serial.println("Reading EEPROM");
    
    while (adres < 2048)
    {
      byte data = eeprom.readByte(adres);
  
      Serial.print(adres);
      Serial.print(", 0x");
      if(data < 0x10) Serial.print("0");
      Serial.println(data, HEX);
    
      adres++;   
    }

    Serial.println("Going to write in 5 seconds");
    delay(5000);

    for(int k=0; k<2048; k++)
    { Serial.println("Writing " + String(k) + " : " + String(arr[k])); 
      eeprom.writeByte(k,arr[k]);
    }
   
    bool okay = true;
    Serial.println("Finished, verifying");  

    for(int k=0; k<2048; k++)
      {
        if(eeprom.readByte(k) != arr[k])
        {   okay = false;
            Serial.println("error at " + String(k));
        }
      }

      if(okay)
        Serial.println("Verified");
      else
        Serial.println("ERROR");

}

void loop() 
{
  
}
